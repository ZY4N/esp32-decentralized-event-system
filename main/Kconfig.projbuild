## main/Kconfig.projbuild
```kconfig
menu "Node Configuration"

	config AP_SSID
		string "The SSID of the wifi AP"
		default "event test wifi"
		help
			The SSID of the wifi AP used for communication between nodes.

	config AP_PASSWORD
		string "The password of the settings WAP (change before using)"
		default "dAOxHZY6vD2cGuMtUjWMqXx3mnGZs6Nw"
		help
			The password of the Wireless-Access-Point created by the ESP
			for the initial setup.

	config PASSWORD_MAX_LEN
		int "maximun length of password string"
		default 32

	config BROADCAST_PORT
		int "broadcast port"
		default 34000
		help
			The port over which UDP broadcast messages are sent and redeived.

	config CHALLENGE_PORT
		int "Challenge connection port"
		default 34001
		help
			The port over which TCP challenges are sent and redeived.

	config TCP_INITIAL_LISTEN_TIMEOUT_MS
		int "initial TCP listen timeout ms"
		default 1000
		help
			Maximum time waited for TCP challenge connection.

	config TCP_QUEUED_LISTEN_TIMEOUT_MS
		int "TCP listen timeout ms after requests have been queued"
		default 100
		help
			Maximum time waited for TCP challenge connection after requests have been queued by OS.

	config CHALLNGE_TIME_PER_NODE
		int "Challenge time per node"
		default 1000
		help
			The approximated time need to fully answer one challenge.

	config TCP_COMMUNICATON_TIMEOUT
		int "TCP communication timeout"
		default 300
		help
			The timeout for TCP sends and receives. 

	config UDP_COMMUNICATON_RETRIES
		int "Number of UDP communication retries"
		default 3
		help
			The maximum number of retries a UDP send/receive is given when temporary errors occur.
			
	config TCP_COMMUNICATON_RETRIES
		int "Number of TCP communication retries"
		default 3
		help
			The maximum number of retries a TCP send/receive is given when temporary errors occur.

	config EVENT_RESEND_COUNT
		int "Number of event resends"
		default 2
		help
			The number of resends for one event.

	config TEST_TASK
		bool "run test task"
		help
			Decides whether the test task is run.

	config WIFI_AP_TASK
		bool "run wifi ap task"
		help
			Decides whether the wifi ap task is run.

	config SENDER_NODE_TASK
		bool "run sender node task"
		help
			Decides whether the sender node task is run.

	config RECEIVER_NODE_TASK
		bool "run receiver node task"
		help
			Decides whether the receiver node task is run.

	config SENDER_ID
		int "Sender ID"
		default 0
		help
			The sender id used with regards to signing

endmenu
```
